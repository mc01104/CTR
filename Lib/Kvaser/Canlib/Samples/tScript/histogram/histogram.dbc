VERSION "HIPBNYYYYYYYYYYYYYYYYYYYYYYYYYYYYYYYYYYYYY/4/%%%/4/'%**4YYY///"

NS_ :

BS_:

BU_:

BO_ 501 ECM_001: 8 Vector__XXX
 SG_ EngineSpeed : 0|32@1+ (1,0) [0|6000] "rpm" Vector__XXX

BO_ 402 LIM_002: 8 Vector__XXX
 SG_ Load : 0|32@1- (1,0) [0|100] "metric ton" Vector__XXX

BO_ 503 ECM_003: 8 Vector__XXX
 SG_ EngineTemp : 0|32@1- (1,0) [-60|200] "Celsius" Vector__XXX

BO_ 504 ECM_004: 8 Vector__XXX
 SG_ Fuel : 0|32@1- (1,0) [0|300] "l/100 km" Vector__XXX

SIG_VALTYPE_ 402 Load : 1;
SIG_VALTYPE_ 503 EngineTemp : 1;
SIG_VALTYPE_ 504 Fuel : 1;
